## boards/vendor/ats_stm32h745/Kconfig.ats_stm32h745
```kconfig
# ATS STM32H745 板卡配置
#
# SPDX-License-Identifier: Apache-2.0
#
# 这个文件做什么：
# - 定义板级 Kconfig 符号：CONFIG_BOARD_ATS_STM32H745
# - 根据你构建的“板卡目标(target)”选择正确的 SoC 变体
#
# 为什么需要 "select SOC_..._M7/M4"：
# STM32H745 是双核。Zephyr 把每个核建模为不同的 SoC 变体（M7 vs M4）。
# 对应的板卡构建目标通常是：
# - ats_stm32h745/stm32h745xx/m7  -> 选择 SOC_STM32H745XX_M7
# - ats_stm32h745/stm32h745xx/m4  -> 选择 SOC_STM32H745XX_M4

config BOARD_ATS_STM32H745
	select SOC_STM32H745XX_M7 if BOARD_ATS_STM32H745_STM32H745XX_M7
	select SOC_STM32H745XX_M4 if BOARD_ATS_STM32H745_STM32H745XX_M4
```

## boards/vendor/ats_stm32h745/ats_stm32h745_stm32h745xx_m4_defconfig
```kconfig
# SPDX-License-Identifier: Apache-2.0

# M4 上电调试默认配置（板卡目标：ats_stm32h745/stm32h745xx/m4）
#
# 默认尽量保持 M4 精简。
#
# 你要求：M4 不使用串口。
# 因此这里把串口/console 默认关闭（避免与 M7 的 UART7 console 冲突）。
CONFIG_SERIAL=n
CONFIG_CONSOLE=n
CONFIG_UART_CONSOLE=n

CONFIG_GPIO=y
```

## boards/vendor/ats_stm32h745/ats_stm32h745_stm32h745xx_m7_defconfig
```kconfig
# SPDX-License-Identifier: Apache-2.0

# M7 上电调试默认配置（板卡目标：ats_stm32h745/stm32h745xx/m7）

# 在 Cortex-M7 上启用 MPU（内存保护单元）
CONFIG_ARM_MPU=y

# 默认启用 UART + console（console 具体使用哪个 UART 由 DTS 的 chosen 决定）
CONFIG_SERIAL=y
CONFIG_CONSOLE=y
CONFIG_UART_CONSOLE=y

# 一般都会用到 GPIO；后续加外设时再逐步扩展
CONFIG_GPIO=y
```

## boards/vendor/ats_stm32h745/board.yml
```yaml
board:
  name: ats_stm32h745
  full_name: ATS STM32H745IIT6 Board
  vendor: ats
  socs:
    - name: stm32h745xx
```

## boards/vendor/nucleo_h745zi_q/board.yml
```yaml
board:
  # 注意：这里不能叫 nucleo_h745zi_q
  # 因为 Zephyr 主仓库已经自带同名板卡（zephyr/boards/st/nucleo_h745zi_q）。
  # 当你把本仓库作为 --board-root 时，west 会同时扫描两边的 boards，
  # 同名会导致 `west boards` 失败（Board defined multiple times）。
  #
  # 这里我们把它改成 *_ref，表示“学习/参考用的拷贝”，避免与上游冲突。
  name: nucleo_h745zi_q_ref
  full_name: Nucleo H745ZI-Q (Reference Copy)
  vendor: st
  socs:
    - name: stm32h745xx
```

## drivers/Kconfig
```kconfig
# Copyright (c) 2021 Nordic Semiconductor ASA
# SPDX-License-Identifier: Apache-2.0

# 这是本仓库 out-of-tree drivers 的 Kconfig 总入口文件。
#
# 作用：
# - 在 menuconfig 中创建一个顶层菜单 "Drivers"
# - 把 drivers 目录下各个子系统/子目录的 Kconfig 递归包含进来
#
# 注意：
# - 这里的 `rsource "xxx/Kconfig"` 是“相对包含”，路径相对于本文件所在目录
# - 只有当这些子 Kconfig 被 source 进 Zephyr 的 Kconfig 树后，
#   对应的 CONFIG_* 选项才会出现在 menuconfig 中

menu "Drivers"
rsource "blink/Kconfig"
rsource "sensor/Kconfig"
endmenu
```

## drivers/blink/Kconfig
```kconfig
# Copyright (c) 2024 Nordic Semiconductor ASA
# SPDX-License-Identifier: Apache-2.0

# 这里是 blink 子系统（自定义 driver class）Kconfig 入口。
# 它演示：
# - 如何用 menuconfig 创建一个“子系统总开关”（CONFIG_BLINK）
# - 如何在子系统开关打开后，再提供更细粒度的配置/子驱动选择
# - 如何挂接 Zephyr 的日志配置模板（生成 CONFIG_BLINK_LOG_LEVEL 等）

menuconfig BLINK
	bool "Blink device drivers"
	help
	  This option enables the blink custom driver class.

if BLINK

# 驱动初始化优先级（最终会传给 DEVICE_DT_INST_DEFINE 的 init priority）
# 越小越早初始化。Zephyr 常用默认值是 KERNEL_INIT_PRIORITY_DEVICE。
config BLINK_INIT_PRIORITY
	int "Blink device drivers init priority"
	default KERNEL_INIT_PRIORITY_DEVICE
	help
	  Blink device drivers init priority.

# 下面这段是 Zephyr 日志模板的“模块信息”：
# - module/module-str 用来生成日志配置项，例如 CONFIG_BLINK_LOG_LEVEL
# - source "subsys/logging/Kconfig.template.log_config" 会引入通用日志选项模板
module = BLINK
module-str = blink
source "subsys/logging/Kconfig.template.log_config"

# 引入该子系统下的具体驱动实现开关（可以有多个 Kconfig.*）
rsource "Kconfig.gpio_led"

endif # BLINK
```

## drivers/blink/Kconfig.gpio_led
```kconfig
# Copyright (c) 2024 Nordic Semiconductor ASA
# SPDX-License-Identifier: Apache-2.0

# 这是 blink 子系统的一个具体驱动实现：GPIO 控制的 LED 闪烁驱动。
#
# 常见模式：
# - `depends on DT_HAS_..._ENABLED`：只有 devicetree 里存在对应 compatible 且 status=okay 的节点，
#   才允许使能该驱动（避免“没有硬件实例也编译驱动”的情况）。
# - `select GPIO`：该驱动依赖 GPIO 子系统，选中它能确保相关 Kconfig 自动打开。
#
# 这里的 DT_HAS_BLINK_GPIO_LED_ENABLED 的来源：
# - 来自 binding 的 compatible "blink-gpio-led"
# - 驱动里 DT_DRV_COMPAT 也使用 blink_gpio_led（与 compatible 的符号化转换一致）

config BLINK_GPIO_LED
	bool "GPIO-controlled LED blink driver"
	default y
	depends on DT_HAS_BLINK_GPIO_LED_ENABLED
	select GPIO
	help
	  Enable this option to use the GPIO-controlled LED blink driver. This
	  demonstrates how to implement a driver for a custom driver class.
```

## drivers/sensor/Kconfig
```kconfig
# Copyright (c) 2021 Nordic Semiconductor ASA
# SPDX-License-Identifier: Apache-2.0

# 这里是“复用 Zephyr 现有 driver class”的示例入口。
#
# 关键点：
# - `if SENSOR`：只有当 Zephyr 自带的 sensor 子系统被启用（CONFIG_SENSOR=y），
#   才把本仓库 out-of-tree 的 sensor 驱动选项展示出来。
# - 这样能避免用户在没启用 sensor 子系统时看到不相关选项，也减少依赖冲突。

if SENSOR
rsource "example_sensor/Kconfig"
endif # SENSOR
```

## drivers/sensor/example_sensor/Kconfig
```kconfig
# Copyright (c) 2021 Nordic Semiconductor ASA
# SPDX-License-Identifier: Apache-2.0

# 这是一个示例 sensor 驱动（实现 Zephyr 标准 sensor API）。
#
# `depends on DT_HAS_ZEPHYR_EXAMPLE_SENSOR_ENABLED`：
# - 只有当 devicetree 中存在 compatible 为 "zephyr,example-sensor" 且 status=okay 的节点，
#   才允许启用这个驱动选项。
# - 该 DT_HAS_* 符号由 devicetree 生成，名字与驱动代码中的 DT_DRV_COMPAT
#   （zephyr_example_sensor）保持一致。
#
# `select GPIO`：
# - 该示例驱动通过 GPIO 读取输入电平，所以需要 GPIO 子系统支持。

config EXAMPLE_SENSOR
	bool "Example sensor"
	default y
	depends on DT_HAS_ZEPHYR_EXAMPLE_SENSOR_ENABLED
	select GPIO
	help
	  Enable example sensor
```

## dts/bindings/blink/blink-gpio-leds.yaml
```yaml
# Copyright (c) 2024 Nordic Semiconductor ASA
# SPDX-License-Identifier: Apache-2.0

# 这是一个 Zephyr Devicetree binding（设备树“绑定/约束”）文件：
#
# - 它用 YAML 描述某个 compatible 设备节点允许有哪些属性（properties），属性的类型是什么，
#   是否必选（required），以及属性的含义（description）。
# - 构建时，Zephyr 的 devicetree 工具会读取这些 binding：
#   1) 校验你的 DTS/overlay 里写的属性是否符合规则
#   2) 生成供 C 代码使用的 DT_* 宏（例如 DT_INST_PROP_OR、GPIO_DT_SPEC_INST_GET 等）
#
# 你可以把它理解为：给 devicetree 节点写“schema + 文档 + 校验规则”。
#
description: |
  A generic binding for a GPIO-controlled blinking LED. Note that this binding
  has no vendor prefix, as it does not target a specific device or vendor.

  Example definition in devicetree:

    blink-gpio-led {
        compatible = "blink-gpio-led";
        led-gpios = <&gpio0 0 GPIO_ACTIVE_HIGH>;
        blink-period-ms = <1000>;
    };

# compatible 是 binding 的核心标识之一：
#
# - 你在 DTS 里写的节点必须有 compatible，并且匹配这里的字符串，才能“套用”本 binding 的规则。
# - 在驱动代码里，经常会把 compatible 映射成 DT_DRV_COMPAT：
#     drivers/blink/gpio_led.c 里有：
#       #define DT_DRV_COMPAT blink_gpio_led
#   这对应 compatible "blink-gpio-led"（连字符 '-' 会转换成下划线 '_'）。
#
#   这样一来，DT_INST_FOREACH_STATUS_OKAY(...) 这些宏才能找到 compatible 匹配的实例。
compatible: "blink-gpio-led"

# include 表示“继承/复用”其他通用 binding：
#
# - base.yaml 是 Zephyr 提供的基础 schema（常见字段、通用约束等）
# - 通过 include，你可以少写很多通用字段定义，并确保基础规则一致
include: base.yaml

# properties 定义该 compatible 节点支持的属性集合。
# 每个属性下可写：
# - type：属性值类型（int、string、phandle、phandle-array、boolean 等）
# - required：是否必选（true 表示 DTS 里必须写）
# - description：属性含义（同时也会用于生成文档/提示）
properties:
  led-gpios:
    # type: phandle-array 表示这是一个“引用 + 参数列表”的数组（通常用于 GPIO/I2C/SPI 等）。
    #
    # 对 GPIO 来说，典型写法是：
    #   led-gpios = <&gpio0 0 GPIO_ACTIVE_HIGH>;
    #
    # 解释：
    # - &gpio0：phandle，指向某个 GPIO 控制器节点（也就是 GPIO port 的设备）
    # - 0：GPIO 引脚号（pin）
    # - GPIO_ACTIVE_HIGH：flags，表示“高电平为 active”（如果是低电平点亮就用 ACTIVE_LOW）
    #
    # 驱动里会用 GPIO_DT_SPEC_INST_GET(inst, led_gpios) 把它解析成 gpio_dt_spec：
    # - port/pin/dt_flags 都在这个结构体里，后续用 gpio_pin_configure_dt 等 API 操作
    type: phandle-array
    required: true
    description: GPIO-controlled LED.

  blink-period-ms:
    # type: int 表示一个整数（这里单位是毫秒）。
    #
    # 这个属性不是 required：
    # - 你可以不写；驱动里会用 DT_INST_PROP_OR(inst, blink_period_ms, 0U)
    #   在缺省时拿到 0（表示“默认不自动启动闪烁”）。
    # - 你也可以写一个正整数；驱动 init 时会按该周期启动 k_timer。
    #
    # 对应驱动行为（drivers/blink/gpio_led.c）：
    # - period_ms == 0：不自动开始闪烁，等待应用调用 blink_set_period_ms()
    # - period_ms > 0：init 阶段直接 k_timer_start()，按周期翻转 LED
    type: int
    description: Initial blinking period in milliseconds.
```

## dts/bindings/rs485/my,rs485.yaml
```yaml
compatible: "vendor,rs485"

description: RS485 software controller

properties:
  uart:
    type: phandle
    required: true

  de-gpios:
    type: phandle-array
    required: true
```

## dts/bindings/sensor/zephyr,example-sensor.yaml
```yaml
# Copyright (c) 2021 Nordic Semiconductor ASA
# SPDX-License-Identifier: Apache-2.0

# 这是一个 Zephyr Devicetree binding（设备树 binding）示例：
#
# - 用 YAML 描述 compatible= "zephyr,example-sensor" 的节点允许/需要哪些属性
# - 构建时用于：
#   1) 校验 DTS/overlay 中该节点的写法是否正确
#   2) 生成供驱动使用的 DT_* 宏展开结果
#
# 这个 binding 对应的驱动在本仓库里是 out-of-tree（工程自带的自定义驱动），
# 用于教学：展示“如何在 Zephyr 工程中自定义一个驱动 + binding + devicetree 节点”。
#
description: |
  An example sensor that reads the GPIO level defined in input-gpios. The
  purpose of this sensor is to demonstrate how to create out-of-tree drivers.

  Example definition in devicetree:

    example-sensor {
        compatible = "zephyr,example-sensor";
        input-gpios = <&gpio0 0 (GPIO_PULL_UP | GPIO_ACTIVE_LOW)>;
    };

# compatible 是 binding 的匹配键：
#
# - DTS/overlay 节点只要写了 compatible = "zephyr,example-sensor"，就会套用本 binding 的规则
# - 这里的 "zephyr," 是 vendor 前缀（vendor prefix）：
#   这是一种命名约定，用来避免 compatible 字符串冲突（类似域名/命名空间的概念）。
#
# 在驱动里通常会写：
#   #define DT_DRV_COMPAT zephyr_example_sensor
# 对应 compatible "zephyr,example-sensor"（逗号 ',' 和连字符 '-' 都会转换为下划线 '_'）。
compatible: "zephyr,example-sensor"

# include: base.yaml 表示复用 Zephyr 提供的通用 binding 基类（基础校验规则/通用字段定义）。
include: base.yaml

# properties 定义该 compatible 节点的属性集合。
properties:
  input-gpios:
    # input-gpios：用于描述“要被采样/感知的输入 GPIO 引脚”。
    #
    # type: phandle-array 的典型写法：
    #   input-gpios = <&gpio0 0 (GPIO_PULL_UP | GPIO_ACTIVE_LOW)>;
    #
    # 解释：
    # - &gpio0：phandle，指向 GPIO 控制器节点（GPIO port 的设备）
    # - 0：引脚号 pin
    # - (GPIO_PULL_UP | GPIO_ACTIVE_LOW)：flags
    #   GPIO_PULL_UP：开启内部上拉
    #   GPIO_ACTIVE_LOW：低电平表示 active（对一些按键/传感器常见）
    #
    # 驱动侧常用 GPIO_DT_SPEC_* 宏把它解析成 struct gpio_dt_spec，然后：
    # - init 时用 gpio_pin_configure_dt(...) 配为输入
    # - 读取时用 gpio_pin_get_dt(...) 读电平，从而实现“示例传感器”
    type: phandle-array
    required: true
    description: Input GPIO to be sensed.
```
